## boards/biii/ch572dk/Kconfig.ch572dk
```kconfig
# Copyright (c) 2024 Michael Hope
# SPDX-License-Identifier: Apache-2.0

config BOARD_CH572DK
	select SOC_CH572D
```

## boards/biii/ch572dk/board.yml
```yaml
board:
  name: ch572dk
  full_name: BIII CH572DK
  vendor: biii
  socs:
    - name: ch572
```

## boards/biii/ch572dk/ch572dk_defconfig
```kconfig
# Copyright (c) 2024 Michael Hope
# SPDX-License-Identifier: Apache-2.0

CONFIG_GPIO=y
```

## drivers/clock_control/Kconfig.wch_rcc
```kconfig
# Copyright (c) 2024 Michael Hope
# SPDX-License-Identifier: Apache-2.0

config CLOCK_CONTROL_WCH_RCC
	bool "WCH CH32V00x Reset and Clock Control (RCC) driver"
	default y
	depends on DT_HAS_WCH_RCC_ENABLED

config CLOCK_CONTROL_WCH_CH5XX_RCC
	bool "WCH CH5XX Reset and Clock Control (RCC) driver"
	default y
	depends on DT_HAS_WCH_CH5XX_RCC_ENABLED
```

## drivers/gpio/Kconfig.wch_ch5xx
```kconfig
# Copyright (c) 2024 Michael Hope
# SPDX-License-Identifier: Apache-2.0

config GPIO_WCH_CH5XX_GPIO
	bool "WCH CH5XX GPIO driver"
	depends on DT_HAS_WCH_CH5XX_GPIO_ENABLED
	default y

config GPIO_WCH_CH5XX_GPIO_INTERRUPTS
	bool "Interrupt support"
	depends on GPIO_WCH_CH5XX_GPIO
	default y
	help
	  Support triggering an interrupt on pin change.
```

## drivers/pinctrl/Kconfig.wch_ch5xx_afio
```kconfig
# Copyright (c) 2024 Michael Hope
# SPDX-License-Identifier: Apache-2.0

config PINCTRL_WCH_CH5XX_AFIO
	bool "WCH CH5XX AFIO pin controller driver"
	default y
	depends on DT_HAS_WCH_CH5XX_AFIO_ENABLED
	help
	  WCH CH5XX AFIO pin controller driver.
```

## drivers/serial/Kconfig.wch_usart
```kconfig
# Copyright (c) 2024 Google LLC.
# SPDX-License-Identifier: Apache-2.0

config UART_WCH_USART
	bool "CH32V00x USART driver"
	default y
	depends on DT_HAS_WCH_USART_ENABLED
	select SERIAL_HAS_DRIVER
	select SERIAL_SUPPORT_INTERRUPT
	select PINCTRL
	help
	  This option enables the USART driver for CH32V00x SoC family.

config UART_WCH_CH5XX_USART
	bool "CH5XX USART driver"
	default y
	depends on DT_HAS_WCH_CH5XX_USART_ENABLED
	select SERIAL_HAS_DRIVER
	select SERIAL_SUPPORT_INTERRUPT
	select SERIAL_SUPPORT_ASYNC
	select PINCTRL
	help
	  This option enables the USART driver for CH5XX SoC family.
```

## dts/bindings/clock/wch,ch5xx-hse-clock.yaml
```yaml
# Copyright (c) 2025 BIII Tech LLP.
# SPDX-License-Identifier: Apache-2.0

description: WCH CH5xx HSE Clock

compatible: "wch,ch5xx-hse-clock"

include: [fixed-clock.yaml]

properties:
  hse-load-capacitance:
    type: int
    default: 16
    description: |
      Load capacitance for the HSE crystal in picofarads. Valid values: 6, 8, 10, 12, 14, 16, 18, 20.
    enum: [6, 8, 10, 12, 14, 16, 18, 20]

  hse-rated-current:
    type: int
    default: 150
    description: |
      Current in percentage of the rated current for the crystal. Valid values: 75, 100, 125, 150.
    enum: [75, 100, 125, 150]
```

## dts/bindings/clock/wch,ch5xx-lsi-clock.yaml
```yaml
# Copyright (c) 2025 BIII Tech LLP.
# SPDX-License-Identifier: Apache-2.0

description: WCH CH5xx LSI Clock

compatible: "wch,ch5xx-lsi-clock"

include: [fixed-clock.yaml]
```

## dts/bindings/clock/wch,ch5xx-pll-clock.yaml
```yaml
# Copyright (c) 2025 BIII Tech LLP.
# SPDX-License-Identifier: Apache-2.0

description: WCH CH5xx PLL Clock

compatible: "wch,ch5xx-pll-clock"

include: [fixed-clock.yaml]
```

## dts/bindings/clock/wch,ch5xx-rcc.yaml
```yaml
# Copyright (c) 2024 Michael Hope
# SPDX-License-Identifier: Apache-2.0

description: WCH CH32V00x Reset and Clock Control (RCC)

compatible: "wch,ch5xx-rcc"

include: [clock-controller.yaml, base.yaml]

properties:
  "#clock-cells":
    const: 1

  divider:
    description: Clock divider
    type: int
    default: 5
    enum: [2, 3, 4, 5, 6, 7, 8, 9, 10, 11, 12, 13, 14, 15, 16, 17, 18, 19, 20, 21, 22, 23, 24, 25, 26, 27, 28, 29, 30, 31, 32]

  stop-on-halt:
    description: Stop the clock when the CPU is halted for debugging
    type: boolean

clock-cells:
  - id
```

## dts/bindings/cpu/wch,qingke-v3c.yaml
```yaml
# Copyright (c) 2024 MASSDRIVER EI (massdriver.space)
# SPDX-License-Identifier: Apache-2.0

description: WCH QingKe V3C RISC-V MCU

compatible: "wch,qingke-v3c"

include: riscv,cpus.yaml
```

## dts/bindings/gpio/wch,ch5xx-gpio.yaml
```yaml
# Copyright (c) 2024 Michael Hope
# SPDX-License-Identifier: Apache-2.0

description: WCH CH5XX General-Purpose Input/Output (GPIO)

compatible: "wch,ch5xx-gpio"

include: [gpio-controller.yaml, base.yaml]

properties:
  reg:
    required: true

  "#gpio-cells":
    const: 2

gpio-cells:
  - pin
  - flags
```

## dts/bindings/i2c/wch,i2c.yaml
```yaml
# Copyright (c) 2025 Andrei-Edward Popa
# SPDX-License-Identifier: Apache-2.0

description: WCH I2C controller

compatible: "wch,i2c"

include: [i2c-controller.yaml, pinctrl-device.yaml]

properties:
  reg:
    required: true

  clocks:
    description: |
      select clock to enable, before this peripheral can be used
      optional on ch5xx, and required by ch32v family

  interrupts:
    required: true

  pinctrl-0:
    required: true

  pinctrl-names:
    required: true
```

## dts/bindings/interrupt-controller/wch,ch5xx-pfic.yaml
```yaml
# Copyright (c) 2025 BIII Tech LLP.
# SPDX-License-Identifier: Apache-2.0

description: WCH CH5xx Programmable Fast Interrupt Controller (PFIC)

compatible: "wch,ch5xx-pfic"

include: [interrupt-controller.yaml, base.yaml]

properties:
  reg:
    required: true

  "#interrupt-cells":
    const: 3

interrupt-cells:
  - irq
  - priority
  - flags
```

## dts/bindings/pinctrl/wch,ch5xx-afio.yaml
```yaml
# Copyright (c) 2024 Michael Hope
# SPDX-License-Identifier: Apache-2.0


description: WCH CH5xx (CH570/CH572) AFIO pin controller

compatible: "wch,ch5xx-afio"

include: base.yaml

properties:
  reg:
    required: true
  "#address-cells":
    required: true
    const: 1
  "#size-cells":
    required: true
    const: 1

child-binding:
  description: |
    Each child node defines the configuration for a particular pinctrl state.
  child-binding:
    description: |
      The grandchild nodes group pins that share the same pin configuration.

    include:
      - name: pincfg-node.yaml
        property-allowlist:
          - bias-pull-up
          - bias-pull-down
          - output-enable

    properties:
      high-drive:
        type: boolean
        description: |
          Enable high drive strength (20mA) for the pins in this group. 
          Standard drive strength is 5mA.
          This setting applies only to output pins.

      pinmux:
        required: true
        type: array
        description: |
          An array of pins sharing the same group properties. The pins should
          be defined using macros from ch5xx-pinctrl.h.
```

## dts/bindings/serial/wch,ch5xx-usart.yaml
```yaml
description: WCH CH5XX UART

compatible: "wch,ch5xx-usart"

include: [uart-controller.yaml, pinctrl-device.yaml]

properties:
  reg:
    required: true
```

## soc/wch/Kconfig
```kconfig
# Copyright (c) 2024 Michael Hope
# Copyright (c) 2024 Jianxiong Gu
# Copyright (c) 2025 BIII Tech LLP.
# SPDX-License-Identifier: Apache-2.0

config SOC_FAMILY_CH32V
	select RISCV
	select BUILD_OUTPUT_HEX
	select CH32V00X_SYSTICK
	imply XIP

config SOC_FAMILY_CH5XX
	select RISCV
	select BUILD_OUTPUT_HEX
	select CH5XX_SYSTICK
	imply XIP

if SOC_FAMILY_CH32V || SOC_FAMILY_CH5XX

config VECTOR_TABLE_SIZE
	int "Number of Interrupt and Exception Vectors"
	range 20 256
	help
	  This option defines the total number of interrupt and exception
	  vectors in the vector table.

rsource "ch32v/*/Kconfig"
rsource "ch5xx/*/Kconfig"

endif # SOC_FAMILY_CH32V
```

## soc/wch/Kconfig.defconfig
```kconfig
# Copyright (c) 2024 Michael Hope
# Copyright (c) 2024 Jianxiong Gu
# Copyright (c) 2025 BIII Tech LLP.
# SPDX-License-Identifier: Apache-2.0

if SOC_FAMILY_CH32V

rsource "ch32v/*/Kconfig.defconfig"

endif # SOC_FAMILY_CH32V

if SOC_FAMILY_CH5XX

rsource "ch5xx/*/Kconfig.defconfig"

endif # SOC_FAMILY_CH5XX
```

## soc/wch/Kconfig.soc
```kconfig
# Copyright (c) 2024 Michael Hope
# Copyright (c) 2024 Jianxiong Gu
# Copyright (c) 2025 BIII Tech LLP.
# SPDX-License-Identifier: Apache-2.0

config SOC_FAMILY_CH32V
	bool

config SOC_FAMILY_CH5XX
	bool

config SOC_FAMILY
	default "ch32v" if SOC_FAMILY_CH32V
	default "ch5xx" if SOC_FAMILY_CH5XX

rsource "ch32v/*/Kconfig.soc"
rsource "ch5xx/*/Kconfig.soc"
```

## soc/wch/ch5xx/qingke_v3c/Kconfig
```kconfig
# Copyright (c) 2025 BIII Tech LLP.
# SPDX-License-Identifier: Apache-2.0

config SOC_SERIES_QINGKE_V3C
	select RISCV_ISA_RV32I
	select RISCV_ISA_EXT_M
	select RISCV_ISA_EXT_C
	select RISCV_ISA_EXT_ZICSR
	select RISCV_ISA_EXT_ZIFENCEI
```

## soc/wch/ch5xx/qingke_v3c/Kconfig.defconfig.ch572
```kconfig
# Copyright (c) 2025 BIII Tech LLP.
# SPDX-License-Identifier: Apache-2.0

if SOC_CH572D

config VECTOR_TABLE_SIZE
	default 35

config NUM_IRQS
	default 35

endif # SOC_CH572D
```

## soc/wch/ch5xx/qingke_v3c/Kconfig.soc
```kconfig
# Copyright (c) 2025 BIII Tech LLP.
# SPDX-License-Identifier: Apache-2.0

config SOC_SERIES_QINGKE_V3C
	bool
	select SOC_FAMILY_CH5XX

config SOC_SERIES
	default "qingke_v3c" if SOC_SERIES_QINGKE_V3C

rsource "Kconfig.soc.*"
```

## soc/wch/ch5xx/qingke_v3c/Kconfig.soc.ch572
```kconfig
# Copyright (c) 2025 BIII Tech LLP
# SPDX-License-Identifier: Apache-2.0

config SOC_CH572D
	bool
	select SOC_SERIES_QINGKE_V3C

config SOC
	default "ch572d" if SOC_CH572D
```
